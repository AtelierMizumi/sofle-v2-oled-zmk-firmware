## config/west.yml
```yaml
manifest:
  remotes:
    - name: zmkfirmware
      url-base: https://github.com/zmkfirmware
    # support nice_oled and nice_epaper
    - name: mctechnology17
      url-base: https://github.com/mctechnology17
    - name: ateliermizumi
      url-base: https://github.com/AtelierMizumi
  projects:
    - name: zmk
      remote: zmkfirmware
      revision: v0.3.0
      import: app/west.yml
    # support nice_oled and nice_epaper
    - name: zmk-nice-oled
      remote: ateliermizumi
      revision: feature/oled-peripheral-redesign
    - name: hammerbeam-slideshow
      remote: ateliermizumi
      revision: main
  self:
    path: config
```
